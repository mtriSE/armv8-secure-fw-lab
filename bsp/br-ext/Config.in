## bsp/br-ext/Config.in
```kconfig
source "$BR2_EXTERNAL_LAB_PATH/package/optee-client-lab/Config.in"
source "$BR2_EXTERNAL_LAB_PATH/package/optee-test-lab/Config.in"
```

## bsp/br-ext/package/optee-client-lab/Config.in
```kconfig
config BR2_PACKAGE_OPTEE_CLIENT_LAB
	bool "optee-client (third_party/optee_client)"
	select BR2_PACKAGE_UTIL_LINUX
	select BR2_PACKAGE_UTIL_LINUX_LIBS
	select BR2_PACKAGE_UTIL_LINUX_LIBUUID
	help
	  libteec (GlobalPlatform TEE Client API) and tee-supplicant, the
	  Normal-world daemon that serves OP-TEE's requests (loading TAs,
	  secure storage files), built from the pinned submodule.
```

## bsp/br-ext/package/optee-test-lab/Config.in
```kconfig
config BR2_PACKAGE_OPTEE_TEST_LAB
	bool "optee-test (third_party/optee_test)"
	select BR2_PACKAGE_OPTEE_CLIENT_LAB
	select BR2_PACKAGE_OPENSSL
	help
	  xtest (OP-TEE's test suite, Normal-world side) and its Trusted
	  Applications, built against the TA dev kit exported by our
	  optee_os build (LAB_TA_DEV_KIT_DIR, set by bsp/Makefile).
```
